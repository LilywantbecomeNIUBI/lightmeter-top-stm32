#include "ssd1306_i2c.h"
#include <string.h>

#define SSD1306_TIMEOUT_MS 100U

static I2C_HandleTypeDef *ssd1306_i2c = 0;
static uint8_t ssd1306_buffer[SSD1306_WIDTH * SSD1306_HEIGHT / 8U];

static const uint8_t font5x7[][5] = {
  {0x00,0x00,0x00,0x00,0x00}, {0x00,0x00,0x5F,0x00,0x00}, {0x00,0x07,0x00,0x07,0x00}, {0x14,0x7F,0x14,0x7F,0x14},
  {0x24,0x2A,0x7F,0x2A,0x12}, {0x23,0x13,0x08,0x64,0x62}, {0x36,0x49,0x55,0x22,0x50}, {0x00,0x05,0x03,0x00,0x00},
  {0x00,0x1C,0x22,0x41,0x00}, {0x00,0x41,0x22,0x1C,0x00}, {0x14,0x08,0x3E,0x08,0x14}, {0x08,0x08,0x3E,0x08,0x08},
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  {0x00,0x00,0x7F,0x00,0x00}, {0x00,0x41,0x36,0x08,0x00}, {0x08,0x08,0x2A,0x1C,0x08}, {0x08,0x1C,0x2A,0x08,0x08}
};

static HAL_StatusTypeDef ssd1306_command(uint8_t cmd)
{
    uint8_t data[2] = {0x00U, cmd};
    return HAL_I2C_Master_Transmit(ssd1306_i2c, SSD1306_I2C_ADDR, data, 2, SSD1306_TIMEOUT_MS);
}

HAL_StatusTypeDef SSD1306_Init(I2C_HandleTypeDef *hi2c)
{
    if (hi2c == 0) return HAL_ERROR;
    ssd1306_i2c = hi2c;
    HAL_Delay(50);

    if (HAL_I2C_IsDeviceReady(hi2c, SSD1306_I2C_ADDR, 3, SSD1306_TIMEOUT_MS) != HAL_OK) {
        return HAL_ERROR;
    }

    ssd1306_command(0xAE); /* display off */
    ssd1306_command(0x00); /* low column */
    ssd1306_command(0x10); /* high column */
    ssd1306_command(0x40); /* start line */
    ssd1306_command(0x81); ssd1306_command(0xCF); /* contrast, same as example */
    ssd1306_command(0xA1); /* segment remap */
    ssd1306_command(0xC8); /* COM scan direction */
    ssd1306_command(0xA6); /* normal display */
    ssd1306_command(0xA8); ssd1306_command(0x3F); /* multiplex */
    ssd1306_command(0xD3); ssd1306_command(0x00); /* offset */
    ssd1306_command(0xD5); ssd1306_command(0x80); /* clock */
    ssd1306_command(0xD9); ssd1306_command(0xF1); /* precharge */
    ssd1306_command(0xDA); ssd1306_command(0x12); /* COM pins */
    ssd1306_command(0xDB); ssd1306_command(0x30); /* VCOM */
    ssd1306_command(0x20); ssd1306_command(0x02); /* page addressing, same as example */
    ssd1306_command(0x8D); ssd1306_command(0x14); /* charge pump */
    SSD1306_Clear();
    SSD1306_Update();
    ssd1306_command(0xAF); /* display on */
    return HAL_OK;
}

void SSD1306_Clear(void)
{
    memset(ssd1306_buffer, 0, sizeof(ssd1306_buffer));
}

void SSD1306_Update(void)
{
    uint8_t data[SSD1306_WIDTH + 1U];
    if (ssd1306_i2c == 0) return;
    data[0] = 0x40U;
    for (uint8_t page = 0; page < 8U; page++) {
        ssd1306_command((uint8_t)(0xB0U + page));
        ssd1306_command(0x00);
        ssd1306_command(0x10);
        memcpy(&data[1], &ssd1306_buffer[(uint16_t)page * SSD1306_WIDTH], SSD1306_WIDTH);
        HAL_I2C_Master_Transmit(ssd1306_i2c, SSD1306_I2C_ADDR, data, sizeof(data), SSD1306_TIMEOUT_MS);
    }
}

void SSD1306_DrawChar(uint8_t x, uint8_t page, char c)
{
    uint8_t idx;
    if (x >= SSD1306_WIDTH || page >= 8U) return;
    if (c < ' ' || c > '~') c = '?';
    idx = (uint8_t)(c - ' ');
    for (uint8_t col = 0; col < 5U; col++) {
        if ((x + col) < SSD1306_WIDTH) {
            ssd1306_buffer[(uint16_t)page * SSD1306_WIDTH + x + col] = font5x7[idx][col];
        }
    }
    if ((x + 5U) < SSD1306_WIDTH) {
        ssd1306_buffer[(uint16_t)page * SSD1306_WIDTH + x + 5U] = 0x00U;
    }
}

void SSD1306_DrawString(uint8_t x, uint8_t page, const char *str)
{
    if (str == 0) return;
    while (*str != '\0' && x < (SSD1306_WIDTH - 5U)) {
        SSD1306_DrawChar(x, page, *str++);
        x = (uint8_t)(x + 6U);
    }
}


void SSD1306_DrawPixel(uint8_t x, uint8_t y, uint8_t color)
{
    if (x >= SSD1306_WIDTH || y >= SSD1306_HEIGHT) return;

    uint16_t index = (uint16_t)(y / 8U) * SSD1306_WIDTH + x;
    uint8_t mask = (uint8_t)(1U << (y % 8U));

    if (color != 0U) {
        ssd1306_buffer[index] |= mask;
    } else {
        ssd1306_buffer[index] &= (uint8_t)(~mask);
    }
}

void SSD1306_DrawHLine(uint8_t x, uint8_t y, uint8_t w, uint8_t color)
{
    for (uint8_t i = 0U; i < w; i++) {
        SSD1306_DrawPixel((uint8_t)(x + i), y, color);
    }
}

void SSD1306_DrawRect(uint8_t x, uint8_t y, uint8_t w, uint8_t h, uint8_t color)
{
    if (w == 0U || h == 0U) return;

    SSD1306_DrawHLine(x, y, w, color);
    SSD1306_DrawHLine(x, (uint8_t)(y + h - 1U), w, color);

    for (uint8_t i = 0U; i < h; i++) {
        SSD1306_DrawPixel(x, (uint8_t)(y + i), color);
        SSD1306_DrawPixel((uint8_t)(x + w - 1U), (uint8_t)(y + i), color);
    }
}
